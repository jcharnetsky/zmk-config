## config/boards/shields/altoidsio-nicenano/Kconfig.defconfig
```kconfig
if SHIELD_ALTOIDSIO-NICENANO

config ZMK_KEYBOARD_NAME
    default "Altoid IO"

endif
```

## config/boards/shields/altoidsio-nicenano/Kconfig.shield
```kconfig
config SHIELD_ALTOIDSIO-NICENANO
    def_bool $(shields_list_contains,altoidsio-nicenano)
```

## config/boards/shields/altoidsio-xiao/Kconfig.defconfig
```kconfig
if SHIELD_ALTOIDSIO-XIAO

config ZMK_KEYBOARD_NAME
    default "Altoid IO"

endif
```

## config/boards/shields/altoidsio-xiao/Kconfig.shield
```kconfig
config SHIELD_ALTOIDSIO-XIAO
    def_bool $(shields_list_contains,altoidsio-xiao)
```

## config/boards/shields/altoidsio_xiao/Kconfig.defconfig
```kconfig
if SHIELD_ALTOIDSIO_XIAO

config ZMK_KEYBOARD_NAME
    default "Altoid IO"

endif
```

## config/boards/shields/altoidsio_xiao/Kconfig.shield
```kconfig
config SHIELD_ALTOIDSIO_XIAO
    def_bool $(shields_list_contains,altoidsio_xiao)
```
