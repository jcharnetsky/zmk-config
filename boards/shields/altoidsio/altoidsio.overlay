#include <dt-bindings/zmk/matrix_transform.h>

/ {
    chosen {
        zmk,kscan = &kscan0;
    };

    kscan0: kscan_0 {
        compatible = "zmk,kscan-gpio-direct";

        input-gpios
            = <&pro_micro_d 21 (GPIO_ACTIVE_LOW | GPIO_PULL_UP)>
        ,<&pro_micro_d 20 (GPIO_ACTIVE_LOW | GPIO_PULL_UP)>
        ,<&pro_micro_d 19 (GPIO_ACTIVE_LOW | GPIO_PULL_UP)>
        ,<&pro_micro_d 18 (GPIO_ACTIVE_LOW | GPIO_PULL_UP)>
        ,<&pro_micro_d 15 (GPIO_ACTIVE_LOW | GPIO_PULL_UP)>
        ,<&pro_micro_d 14 (GPIO_ACTIVE_LOW | GPIO_PULL_UP)>
        ,<&pro_micro_d 16 (GPIO_ACTIVE_LOW | GPIO_PULL_UP)>
        ,<&pro_micro_d 10 (GPIO_ACTIVE_LOW | GPIO_PULL_UP)>
        ;
    };
};
